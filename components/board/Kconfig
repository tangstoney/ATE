## components/board/Kconfig.projbuild
```kconfig
menu "ATE Board Configuration"

    config BOARD_ATE_P4_ENABLE_LCD
        bool "LCD display present"
        default y
        help
            Enable the board capability flag for the LCD display panel.

    config BOARD_ATE_P4_ENABLE_TOUCH
        bool "Touch controller present"
        default y
        help
            Enable the board capability flag for the touch controller.

    config BOARD_ATE_P4_ENABLE_LED_STRIP
        bool "LED strip present"
        default y
        help
            Enable the board capability flag for the WS2812 status LED strip.

    config BOARD_ATE_P4_LED_STRIP_DATA_GPIO
        int "LED strip data GPIO"
        default 4
        range 0 54
        depends on BOARD_ATE_P4_ENABLE_LED_STRIP
        help
            GPIO used by the WS2812 LED strip RMT data output.

    config BOARD_ATE_P4_ENABLE_USB_DEVICE
        bool "USB device function present"
        default y
        help
            Enable the board capability flag for USB device mode.

    config BOARD_ATE_P4_ENABLE_USB_HOST
        bool "USB host function present"
        default n
        help
            Enable the board capability flag for USB host mode.

    config BOARD_ATE_P4_ENABLE_ETHERNET
        bool "Ethernet PHY present"
        default y
        help
            Enable the board capability flag for Ethernet.

    config BOARD_ATE_P4_ENABLE_MODULE_I2C
        bool "Module I2C link present"
        default y
        help
            Enable the board capability flag for the downstream module I2C link.

    config BOARD_ATE_P4_ENABLE_INSTRUMENT_UART
        bool "Instrument UART links present"
        default y
        help
            Enable the board capability flag for downstream instrument UART links.

    choice BOARD_ATE_P4_INSTR_LINK_MODE
        prompt "Instrument link wiring mode"
        default BOARD_ATE_P4_ENABLE_RS422
        depends on BOARD_ATE_P4_ENABLE_INSTRUMENT_UART
        help
            Select the physical wiring mode for downstream instrument links.
            RS422 uses full-duplex UART_MODE_UART.
            RS485 half-duplex uses UART_MODE_RS485_HALF_DUPLEX.

        config BOARD_ATE_P4_ENABLE_RS422
            bool "RS422 full-duplex"
            help
                Instrument link is wired as RS422. No direction control needed.

        config BOARD_ATE_P4_ENABLE_RS485_HALF
            bool "RS485 half-duplex"
            help
                Instrument link is wired as RS485. RTS pin controls DE or RE.

    endchoice

    config BOARD_ATE_P4_INSTRUMENT_UART_BAUD_DEFAULT
        int "Default baud rate for instrument links"
        default 115200
        range 1200 3000000
        help
            Default baud rate for downstream instrument UART links.

    config BOARD_ATE_P4_MODULE_I2C_PORT
        int "I2C port number for module bus"
        default 0
        range 0 1
        help
            I2C master port used for test module communication.

    config BOARD_ATE_P4_MODULE_I2C_CLK_HZ
        int "Default I2C clock frequency for module bus"
        default 400000
        range 10000 1000000
        help
            Default module I2C bus clock frequency in Hertz.

    config BOARD_ATE_P4_MODULE_I2C_ADDR
        hex "Fixed I2C address for module bus"
        default 0x11
        help
            Fixed 7-bit I2C slave address for the downstream test module.
            The current default 0x11 is a temporary test address and can be
            changed later in the board configuration when the real module
            address is confirmed.

    config BOARD_ATE_P4_TOUCH_I2C_ADDR
        hex "Default GT911 I2C address"
        default 0x5D
        help
            Default I2C address used by the GT911 touch controller.

endmenu
```

## components/driver/driver_display/Kconfig
```kconfig
menu "Driver Display Configuration"

    config DRIVER_DISPLAY_TOUCH_ENABLED
        bool "Enable touch controller (GT911)"
        default y
        help
            Enable GT911 touch support for the display stack.
            Disable this for display-only builds.

endmenu
```

## components/driver/driver_i2c_module/Kconfig
```kconfig
menu "Driver I2C Module Configuration"

    config DRIVER_I2C_MODULE_PORT
        int "Module I2C port fallback"
        default BOARD_ATE_P4_MODULE_I2C_PORT
        range 0 1
        help
            Fallback I2C port used when board_ate_p4.h does not provide a valid
            module bus port. Board wiring remains the primary source of truth.

    config DRIVER_I2C_MODULE_SCL_GPIO
        int "Module I2C SCL GPIO fallback"
        default -1
        range -1 63
        help
            Fallback SCL GPIO used only when board_ate_p4.h leaves the module
            bus SCL pin unconfigured.

    config DRIVER_I2C_MODULE_SDA_GPIO
        int "Module I2C SDA GPIO fallback"
        default -1
        range -1 63
        help
            Fallback SDA GPIO used only when board_ate_p4.h leaves the module
            bus SDA pin unconfigured.

    config DRIVER_I2C_MODULE_USE_INTERNAL_PULLUP
        bool "Use internal I2C pullups as fallback"
        default n
        help
            Enable ESP32 internal pull-up resistors when the board layer does
            not already request them. External pull-ups are still preferred.

endmenu
```

## components/driver/driver_lcd_panel/Kconfig
```kconfig
menu "Driver LCD Panel Configuration"

    config DRIVER_LCD_H_RES
        int "LCD horizontal resolution"
        default 800
        range 1 4096

    config DRIVER_LCD_V_RES
        int "LCD vertical resolution"
        default 1280
        range 1 4096

    config DRIVER_LCD_POWER_EN_GPIO
        int "LCD power enable GPIO"
        default 45
        range -1 63

    config DRIVER_LCD_ENABLE_GPIO
        int "LCD enable GPIO"
        default 53
        range -1 63

    config DRIVER_LCD_BACKLIGHT_GPIO
        int "LCD backlight GPIO"
        default 21
        range -1 63

    config DRIVER_LCD_RESET_GPIO
        int "LCD reset GPIO"
        default 27
        range -1 63

    config DRIVER_LCD_MIPI_LDO_CHAN
        int "MIPI PHY LDO channel"
        default 3
        range 0 7

    config DRIVER_LCD_MIPI_LDO_MV
        int "MIPI PHY LDO voltage (mV)"
        default 2500
        range 1000 5000

    config DRIVER_LCD_DSI_BUS_ID
        int "MIPI DSI bus ID"
        default 0
        range 0 7

    config DRIVER_LCD_DSI_LANE_NUM
        int "MIPI DSI lane count"
        default 2
        range 1 4

    config DRIVER_LCD_DSI_LANE_BIT_RATE_MBPS
        int "MIPI DSI lane bitrate (Mbps)"
        default 1500
        range 80 2500

    config DRIVER_LCD_DBI_VIRTUAL_CHANNEL
        int "MIPI DBI virtual channel"
        default 0
        range 0 3

    config DRIVER_LCD_DPI_VIRTUAL_CHANNEL
        int "MIPI DPI virtual channel"
        default 0
        range 0 3

    config DRIVER_LCD_DPI_CLK_MHZ
        int "MIPI DPI clock (MHz)"
        default 80
        range 1 200

    config DRIVER_LCD_NUM_FBS
        int "Number of frame buffers"
        default 2
        range 1 3

    config DRIVER_LCD_HSYNC_BACK_PORCH
        int "HSYNC back porch"
        default 20
        range 0 1024

    config DRIVER_LCD_HSYNC_PULSE_WIDTH
        int "HSYNC pulse width"
        default 20
        range 0 1024

    config DRIVER_LCD_HSYNC_FRONT_PORCH
        int "HSYNC front porch"
        default 40
        range 0 1024

    config DRIVER_LCD_VSYNC_BACK_PORCH
        int "VSYNC back porch"
        default 10
        range 0 1024

    config DRIVER_LCD_VSYNC_PULSE_WIDTH
        int "VSYNC pulse width"
        default 4
        range 0 1024

    config DRIVER_LCD_VSYNC_FRONT_PORCH
        int "VSYNC front porch"
        default 30
        range 0 1024

    config DRIVER_LCD_USE_DMA2D
        bool "Enable DMA2D for LCD"
        default y

    config DRIVER_LCD_SWAP_XY
        bool "Swap LCD X/Y axes"
        default n

    config DRIVER_LCD_MIRROR_X
        bool "Mirror LCD X axis"
        default n

    config DRIVER_LCD_MIRROR_Y
        bool "Mirror LCD Y axis"
        default n

endmenu
```

## components/driver/driver_touch_gt911/Kconfig
```kconfig
menu "Driver Touch GT911 Configuration"

    config DRIVER_TOUCH_GT911_X_MAX
        int "GT911 X max"
        default 800
        range 240 4096
        help
            Maximum raw X coordinate reported by the GT911 controller.
            Set this to the touch sensor horizontal range before any swap or mirror mapping.

    config DRIVER_TOUCH_GT911_Y_MAX
        int "GT911 Y max"
        default 1280
        range 240 4096
        help
            Maximum raw Y coordinate reported by the GT911 controller.
            Set this to the touch sensor vertical range before any swap or mirror mapping.

    config DRIVER_TOUCH_GT911_I2C_PORT
        int "GT911 I2C port"
        default 0
        range 0 1
        help
            I2C master port used to communicate with the GT911 touch controller.
            This must match the board wiring for the touch bus.

    config DRIVER_TOUCH_GT911_I2C_SCL_GPIO
        int "GT911 I2C SCL GPIO"
        default 8
        range -1 63
        help
            GPIO number connected to the GT911 I2C SCL signal.
            Configure this according to the board schematic.

    config DRIVER_TOUCH_GT911_I2C_SDA_GPIO
        int "GT911 I2C SDA GPIO"
        default 7
        range -1 63
        help
            GPIO number connected to the GT911 I2C SDA signal.
            Configure this according to the board schematic.

    config DRIVER_TOUCH_GT911_I2C_CLK_HZ
        int "GT911 I2C clock frequency (Hz)"
        default 400000
        range 10000 400000
        help
            GT911 I2C bus frequency in Hz.
            GT911 supports up to 400kHz (Fast Mode). Do not exceed this value.

    config DRIVER_TOUCH_GT911_I2C_ADDR
        hex "GT911 I2C address"
        default 0x5D
        help
            GT911 I2C address.
            Default is 0x5D. Use 0x14 when INT pin is pulled low during reset.

    config DRIVER_TOUCH_GT911_RESET_GPIO
        int "GT911 reset GPIO"
        default -1
        range -1 63
        help
            GPIO connected to the GT911 reset pin.
            Set to -1 when the reset pin is not controlled by software.

    config DRIVER_TOUCH_GT911_INT_GPIO
        int "GT911 interrupt GPIO"
        default -1
        range -1 63
        help
            GPIO connected to the GT911 interrupt pin.
            Set to -1 when the interrupt pin is not connected or not used.

    config DRIVER_TOUCH_GT911_USE_INTERNAL_PULLUP
        bool "Use internal I2C pullups"
        default n
        help
            Enable ESP32 internal pull-up resistors for SDA and SCL.
            Only use this when no external pull-up resistors are present on the board.
            If GPIO conflict warnings appear, check the board pull-up design first.

    config DRIVER_TOUCH_GT911_SWAP_XY
        bool "Swap touch X/Y axes"
        default n
        help
            Touch mapping is independent from LCD rotation.
            Use this only when the raw GT911 X/Y axes are physically swapped.

    config DRIVER_TOUCH_GT911_MIRROR_X
        bool "Mirror touch X axis"
        default n
        help
            Touch mapping is independent from LCD rotation.
            Mirror the raw GT911 X axis output.
            Some Waveshare ESP32-P4 and JD9365 board layouts need this enabled.
            Adjust this for your specific hardware layout.

    config DRIVER_TOUCH_GT911_MIRROR_Y
        bool "Mirror touch Y axis"
        default n
        help
            Touch mapping is independent from LCD rotation.
            Enable this when the raw Y axis is reversed relative to the UI.
            This is board-specific and may differ on other GT911 layouts.

endmenu
```
